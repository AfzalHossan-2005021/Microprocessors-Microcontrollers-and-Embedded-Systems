/*
 * u8g2_demo.c
 *
 * Created: 2/21/2024 8:02:58 PM
 * Author : Afzal Hossan
 */ 

#include <avr/io.h>
#include <util/delay.h>
#include <u8g2.h>
#include <u8x8_Wrapper.h>
#include <inttypes.h>
#include <string.h>
#include <USART.h>
#include <I2C.h>
#include <ADC.h>

#define OLED_ADDR  0x78

u8g2_t u8g2;
char buffer[32]; // helper buffer to construct a string to be displayed
unsigned char last_y = 0;

const unsigned char OXYMETER_PROMPT [] PROGMEM = {
	0xff, 0xff, 0xff, 0xff, 0xff, 0xff, 0xff, 0xff, 0xff, 0xff, 0xff, 0xff, 0xff, 0xff, 0xff, 0xff,
	0xff, 0xff, 0xff, 0xff, 0xff, 0xff, 0xff, 0xff, 0xff, 0xff, 0xff, 0xff, 0xff, 0xff, 0xff, 0xff,
	0xff, 0xff, 0xff, 0xff, 0xff, 0xff, 0xff, 0xff, 0xff, 0xff, 0xff, 0xff, 0xff, 0xff, 0xff, 0xff,
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	0xff, 0xff, 0xff, 0xff, 0xff, 0xff, 0xff, 0xff, 0xff, 0xff, 0xff, 0xff, 0xff, 0xff, 0xff, 0xff
};

const unsigned char ECG_PROMPT [] PROGMEM = {
	0xff, 0xff, 0xff, 0xff, 0xff, 0xff, 0xff, 0xff, 0xff, 0xff, 0xff, 0xff, 0xff, 0xff, 0xff, 0xff,
	0xff, 0xff, 0xff, 0xff, 0xff, 0xff, 0xff, 0xff, 0xff, 0xff, 0xff, 0xff, 0xff, 0xff, 0xff, 0xff,
	0xff, 0xff, 0xff, 0xff, 0xff, 0xff, 0x7f, 0x00, 0xfc, 0xff, 0x07, 0xc0, 0xff, 0xff, 0xff, 0xff,
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	0xff, 0xff, 0xff, 0xff, 0xff, 0xff, 0xff, 0xff, 0xff, 0xff, 0xff, 0xff, 0xff, 0xff, 0xff, 0xff
};

const unsigned char QR_CODE [] PROGMEM = {
	0xff, 0xff, 0xff, 0xff, 0xff, 0xff, 0xff, 0xff, 0xff, 0xff, 0xff, 0xff, 0xff, 0xff, 0xff, 0xff,
	0xff, 0xff, 0xff, 0xff, 0xff, 0xff, 0xff, 0xff, 0xff, 0xff, 0xff, 0xff, 0xff, 0xff, 0xff, 0xff,
	0xff, 0xff, 0xff, 0xff, 0xff, 0xff, 0xff, 0xff, 0xff, 0xff, 0xff, 0xff, 0xff, 0xff, 0xff, 0xff,
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	0xff, 0xff, 0xff, 0xff, 0xff, 0xff, 0xff, 0xff, 0xff, 0xff, 0xff, 0xff, 0xff, 0xff, 0xff, 0xff
};

void OLED_init(){
	u8g2_Setup_sh1106_i2c_128x64_noname_f(&u8g2, U8G2_R0, u8x8_byte, u8x8_delay);
	u8g2_SetI2CAddress(&u8g2, OLED_ADDR);
	u8g2_InitDisplay(&u8g2);
	u8g2_SetPowerSave(&u8g2, 0);
}

void initialize(){
	DDRA &= ~(1 << PA1); // Pin 1 of Port A as input
	DDRA &= ~(1 << PA2); // Pin 2 of Port A as input
	DDRB = 0x00;
	DDRD = 0x00;
	ADC_init();
	I2C_Init();
	USART_Init(9600);
	OLED_init();
}

void valToStr(char *result, int x){
	if(x <= 0){
		result[0] = '0';
		result[1] = '\0';
		return;
	}
	if(x > 100){
		result[0] = '1';
		result[1] = '0';
		result[2] = '0';
		result[3] = '\0';
		return;
	}
	int k,i=0,j;
	while(x>0){
		k = x%10;
		result[i] = k+'0';
		x/=10;
		i++;
	}
	char temp;
	result[i] = '\0';
	for(j=0;j<i/2;j++){
		temp = result[j];
		result[j]= result[i-1-j];
		result[i-1-j] = temp;
	}
}


int main (void)
{
	initialize();

	unsigned char mode = 0, show_QR = 0;
	unsigned char fromB, fromD;
	
	fromD = PIND;
	mode = fromD & 0x80;
	
	while(1){
		while (!mode) {
			fromD = PIND;
			mode = fromD & 0x80;
			
			unsigned char LO_neg = PINA & (1 << PA1);
			unsigned char LO_pos = PINA & (1 << PA2);
			
			if(LO_neg || LO_pos){
				u8g2_ClearBuffer(&u8g2);
				u8g2_DrawXBMP(&u8g2, 0, 0, 128, 64, ECG_PROMPT);
				u8g2_SendBuffer(&u8g2);
			} else {
				u8g2_ClearBuffer(&u8g2);
				for (int x = 0; x < 128; x+=4) {
					unsigned char y = ADC_read(0);
					if (x > 0) {
						u8g2_DrawLine(&u8g2, x - 4, 63 - last_y, x, 63 - y);
					}
					last_y = y;
				}
				u8g2_SendBuffer(&u8g2);
			}
		}
		
		while(mode){
			fromB = PINB;
			fromD = PIND;
			show_QR = fromB & 0x80;
			mode = fromD & 0x80;
			
			if(show_QR){
				u8g2_ClearBuffer(&u8g2);
				u8g2_DrawXBMP(&u8g2, 32, 0, 64, 64, QR_CODE);
				u8g2_SendBuffer(&u8g2);
			} else {
				u8g2_ClearBuffer(&u8g2);
				u8g2_SetFont(&u8g2, u8g2_font_helvB12_tf);
				u8g2_SetFontPosTop(&u8g2);
				int spo2 = fromB & 0x7F;
				int hr = fromD & 0x7C;
				if(!spo2 || !hr){
					u8g2_ClearBuffer(&u8g2);
					u8g2_DrawXBMP(&u8g2, 0, 0, 128, 64, OXYMETER_PROMPT);
					u8g2_SendBuffer(&u8g2);
				} else {
					char fohr[100]="HR: ";
					char ohr[10];
					valToStr(ohr,hr);
					strcat(ohr," bpm");
					strcat(fohr,ohr);
					u8g2_DrawStr(&u8g2, 16, 12, fohr);
					char output[10];
					char final[100] = "SPO2: ";
					valToStr(output,spo2);
					strcat(output," %");
					strcat(final,output);
					u8g2_DrawStr(&u8g2, 16, 36, final);
					u8g2_SendBuffer(&u8g2);
					
					USART_SendString(fohr);
					USART_SendString(final);
				}
			}
		}	
	}
	return 0;
}



